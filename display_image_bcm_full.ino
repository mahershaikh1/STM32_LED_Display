// 8:00 PM wed night
// trying to display an image 
// wokring on BCM


// PANEL definitions
#define WIDTH 64 // will change to 128
#define HEIGHT 32

//// GPIO definitions
//#define R1 44 //PB13 R1
//#define G1 13 // PA5 G1
//#define B1 42 //PB15 B1
//
//#define R2 12 //PA6 R2
//#define G2 6 //PB10 G2
//#define B2 50 //PC1 B2
//
//#define CLK 1 // PA2 CLOCK
//#define OE 0 // PA3 OE
//#define LE 11 // PA7 LATCH
//
//#define A 28 // PC2 A
//#define B 29 // PC3 B
//#define C 38 // PB12 C
//#define D 43 // PB14 D

// GPIO definitions
#define R1 44 //PB13 R1
#define B1 42 //PB15 B1

#define B2 50 //PC1 B2

#define OE 0 // PA3 OE
#define A 28 // PC2 A
#define B 29 // PC3 B


/* MODIFIED PIN MAPPINGS */
//#define G1 13 // PA5 G1
#define G1 51 // PC0 // DONE

//#define R2 12 //PA6 R2
#define R2 41 // PB1 // DONE

//#define LE 11 // PA7 LATCH
#define LE 47 // PA1 // DONE

//#define C 38 // PB12 C
#define C 46 // PA0 // DONE

//#define D 43 // PB14 D
#define D 40 // PB2 // DONE

//#define CLK 1 // PA2 CLOCK
#define CLK 35 // PC5 // DONE

//#define G2 6 //PB10 G2
#define G2 45 // PC4





void setup() {

  // GPIO configs
  pinMode(R1, OUTPUT); 
  pinMode(G1, OUTPUT); 
  pinMode(B1, OUTPUT); 
  
  pinMode(R2, OUTPUT); 
  pinMode(G2, OUTPUT); 
  pinMode(B2, OUTPUT); 
  
  pinMode(CLK, OUTPUT); 
  pinMode(OE, OUTPUT); 
  pinMode(LE, OUTPUT); 
  
  pinMode(A, OUTPUT); 
  pinMode(B, OUTPUT); 
  pinMode(C, OUTPUT); 
  pinMode(D, OUTPUT); 


}

// global vars
int color_depth = 4;


void loop() 
{  
  int i = 0, ii = 0;
  int col_index = 0; // goes 0 to 63
  int rowCounter = 0; // goes 0 to 15
  int row_index;
  uint8_t r1, g1, b1, r2, g2, b2;
  uint8_t bitr1, bitg1, bitb1, bitr2, bitg2, bitb2;
  
uint8_t image[] = {15,15,15,15,15,15,15,15,15,15,15,15,15,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15,15};

//uint8_t image[] = {15,15,15,15,15,15,15,15,15,15,15,15,15,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15,15};
  
  digitalWrite(R1, LOW); // R1
  digitalWrite(G1, LOW); //G1
  digitalWrite(B1, LOW); //B1

  digitalWrite(12, LOW); // R2
  digitalWrite(6, LOW); //G2
  digitalWrite(50, LOW); //B2
  
  digitalWrite(OE, LOW); // was LOW IDK!!!!!!!
  digitalWrite(LE, LOW);

  // row switching


  digitalWrite(CLK, LOW);


  while(1)
  {
    for(row_index = 0; row_index<(HEIGHT/2); row_index++)
    {

       digitalWrite(A, ((rowCounter & 1) > 0)); // STEP 3 (SELECT ROW)
       digitalWrite(B, ((rowCounter & 2) > 0));
       digitalWrite(C, ((rowCounter & 4) > 0));
       digitalWrite(D, ((rowCounter & 8) > 0));
  
       for(ii=0; ii<color_depth; ii++) // should cycle through the bits 0-3
       {
          digitalWrite(OE, HIGH); // turn off display
          
          for(col_index=0; col_index<64; col_index++) // STEP 1 col_index is the pixl we want
          {
            // grab the pixel r g b we want
//            r1 = image[3*((32*col_index)+row_index) + 0];
//            g1 = image[3*((32*col_index)+row_index) + 1];
//            b1 = image[3*((32*col_index)+row_index) + 2];
//

//            r2 = image[(3*(((32*col_index)+row_index)) + 0)+3*64];
//            g2 = image[(3*(((32*col_index)+row_index)) + 1)+3*64];
//            b2 = image[(3*(((32*col_index)+row_index)) + 2)+3*64];
//
            r1 = image[3*((64*(row_index))+col_index) + 0]; // MAYBE WORKS
            g1 = image[3*((64*(row_index))+col_index) + 1];
            b1 = image[3*((64*(row_index))+col_index) + 2];

            r2 = image[3*((64*(row_index+16))+col_index) + 0]; // MAYBE WORKS
            g2 = image[3*((64*(row_index+16))+col_index) + 1];
            b2 = image[3*((64*(row_index+16))+col_index) + 2];
//            
//            // grab individual bits
            bitr1 = bitRead(r1, ii);
            bitg1 = bitRead(g1, ii);
            bitb1 = bitRead(b1, ii);

            bitr2 = bitRead(r2, ii);
            bitg2 = bitRead(g2, ii);
            bitb2 = bitRead(b2, ii);

            
//            bitr2 = 1;
//            bitg2 = 1;
//            bitb2 = 1;
//  
            if(bitr1) { digitalWrite(R1, HIGH); }
            else { digitalWrite(R1, LOW); }
            
            if(bitg1) { digitalWrite(G1, HIGH); }
            else { digitalWrite(G1, LOW); }
            
            if(bitb1) { digitalWrite(B1, HIGH); }
            else { digitalWrite(B1, LOW); }

            if(bitr2) { digitalWrite(R2, HIGH); }
            else { digitalWrite(R2, LOW); }
            
            if(bitg2) { digitalWrite(G2, HIGH); }
            else { digitalWrite(G2, LOW); }
            
            if(bitb2) { digitalWrite(B2, HIGH); }
            else { digitalWrite(B2, LOW); }
              
            digitalWrite(CLK, HIGH);
            digitalWrite(CLK, LOW);
            // at the end of this we should have clocked in all 64 pixels bit ii
          }
                 
          digitalWrite(LE, HIGH); // STEP 4 LATCH 
          digitalWrite(LE, LOW); // STEP 4 LATCH
          digitalWrite(OE, LOW); // STEP 5 DEASSERT OE TO SHOW
          delayMicroseconds(pow(2,ii)); // STEP 6 WAIT SOME AMOUNT OF TIME N   
          digitalWrite(OE, HIGH); // TURN IT OF???!!?!?!?!?
       }

      // GONE THROUGH ALL 4 BITS FOR ALL THE COLORS FOR THE TOP HALF FOR ALL 64 PIXELS
    rowCounter++;
   }
  }

  
  

  


}
